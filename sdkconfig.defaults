## sdkconfig.defaults
```kconfig
CONFIG_ESPTOOLPY_FLASHSIZE_4MB=y
CONFIG_PARTITION_TABLE_SINGLE_APP_LARGE=y
CONFIG_BT_ENABLED=y
CONFIG_BT_NIMBLE_ENABLED=y
CONFIG_ESP_DEFAULT_CPU_FREQ_MHZ_240=y
CONFIG_ESP_TIMER_TASK_STACK_SIZE=8000
CONFIG_FREERTOS_GENERATE_RUN_TIME_STATS=y
CONFIG_LWIP_DEBUG=y
CONFIG_LWIP_DEBUG_ESP_LOG=y
CONFIG_LWIP_NETIF_DEBUG=y
CONFIG_LWIP_PBUF_DEBUG=y
CONFIG_LWIP_API_LIB_DEBUG=y
CONFIG_LWIP_SOCKETS_DEBUG=y
CONFIG_LWIP_IP_DEBUG=y
CONFIG_LWIP_ICMP_DEBUG=y
CONFIG_LWIP_DHCP_STATE_DEBUG=y
CONFIG_LWIP_IP6_DEBUG=y
CONFIG_LWIP_ICMP6_DEBUG=y
CONFIG_LWIP_TCP_DEBUG=y
CONFIG_LWIP_UDP_DEBUG=y
CONFIG_LWIP_SNTP_DEBUG=y
CONFIG_LWIP_DNS_DEBUG=y
CONFIG_LWIP_BRIDGEIF_DEBUG=y
CONFIG_LWIP_BRIDGEIF_FDB_DEBUG=y
CONFIG_LWIP_BRIDGEIF_FW_DEBUG=y
CONFIG_OPENTHREAD_RX_ON_WHEN_IDLE=y
CONFIG_MDNS_MAX_INTERFACES=4
CONFIG_MDNS_ENABLE_DEBUG_PRINTS=y
```
